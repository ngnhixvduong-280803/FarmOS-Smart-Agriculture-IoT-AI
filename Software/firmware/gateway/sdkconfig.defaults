## Software/firmware/node/main/Kconfig.projbuild
```kconfig
menu "FarmOS pump control"

config FARMOS_PUMP_CONTROL
    bool "Enable remote pump control on a commissioned Wi-Fi Node"
    default n
    help
        Requires a hardwired fail-open pump interlock and dedicated,
        electrically isolated permissive and contactor feedback inputs.

config FARMOS_RELAY_BENCH_NODE_V1
    bool "NODE_V1 dry-contact relay bench test (no pump or external load)"
    depends on FARMOS_PUMP_CONTROL
    default n
    help
        Only for NODE_232622412 and an unloaded SPDT relay. GPIO14 reads NO,
        GPIO15 reads NC, and COM is connected to the Node ground. Both
        readings must agree before a command can be confirmed.

config FARMOS_PUMP_PERMISSIVE_GPIO
    int "GPIO for isolated interlock permissive (HIGH when safe)"
    depends on FARMOS_PUMP_CONTROL && !FARMOS_RELAY_BENCH_NODE_V1
    range -1 48
    default -1

config FARMOS_PUMP_FEEDBACK_GPIO
    int "GPIO for isolated contactor feedback (HIGH when energized)"
    depends on FARMOS_PUMP_CONTROL && !FARMOS_RELAY_BENCH_NODE_V1
    range -1 48
    default -1

endmenu
```

## Software/firmware/shared/Kconfig.projbuild
```kconfig
menu "FarmOS identity"
config FARMOS_FACTORY_PLAIN_FLASH
    bool "Use plain flash for USB factory enrollment"
    default n
    depends on !NVS_ENCRYPTION && !SECURE_BOOT && !SECURE_FLASH_ENC_ENABLED
    help
        Dedicated USB factory profile. Requires genuine signed enrollment;
        does not allow development identities or legacy claim bypasses.
        Local flash remains readable; OTA still requires signed applications.

config FARMOS_DEVELOPMENT_IDENTITY
    bool "Allow development identity when factory partition is absent"
    default n
    help
        Enable only for an explicitly requested bench image. Manufactured
        devices must have their own factory identity and attestation key.
endmenu

menu "FarmOS serial enrollment"
config FARMOS_ENROLLMENT_USB_SERIAL_JTAG
    bool "Use native USB Serial/JTAG for enrollment"
    depends on SOC_USB_SERIAL_JTAG_SUPPORTED
    default n
    help
        Use the ESP32-S3 native USB connector for the desktop flasher protocol.
        Disable for boards connected through an external UART0 USB bridge.

config FARMOS_ENROLLMENT_SERVER_PUBLIC_KEY
    string "Enrollment server public key (base64url SPKI DER)"
    default ""
    help
        The public key embedded in the firmware verifies short-lived signed
        enrollment/recovery tickets received over physical UART. Never put a
        server private key in firmware or in this repository. Production
        release profiles must override this value with the approved key.
endmenu
```
